## Kconfig.runtime
```kconfig
#
# For a description of the syntax of this configuration file,
# see kconfig-language at https://www.kernel.org/doc/Documentation/kbuild/kconfig-language.txt
#

config ENABLE_IOTJS
	bool "IoT.js"
	default n
	select SPI_EXCHANGE
	---help---
		Enable IoT.js framework

if ENABLE_IOTJS

config IOTJS_PRIORITY
        int "IoT.js task priority"
        default 100

config IOTJS_STACKSIZE
        int "IoT.js stack size"
        default 32768

config IOTJS_JERRY_HEAP
        int "Jerryscript Heaplimit"
        default 128

endif #ENABLE_IOTJS
```

## config/nuttx/stm32f4dis/app/Kconfig
```kconfig
#
# For a description of the syntax of this configuration file,
# see the file kconfig-language.txt in the NuttX tools repository.
#

config IOTJS
  bool "IoT.js"
  default n
  ---help---
    Enable IoT.js platform

if IOTJS

config IOTJS_PRIORITY
  int "IoT.js task priority"
  default 100

config IOTJS_STACKSIZE
  int "IoT.js stack size"
  default 16384

endif
```

## config/tizenrt/Kconfig.runtime
```kconfig
#
# For a description of the syntax of this configuration file,
# see kconfig-language at https://www.kernel.org/doc/Documentation/kbuild/kconfig-language.txt
#

config ENABLE_IOTJS
	bool "IoT.js"
	default n
	select SPI_EXCHANGE
	select IOTBUS
	select IOTBUS_GPIO
	select IOTBUS_I2C
	select IOTBUS_PWM
	select IOTBUS_SPI
	select IOTBUS_UART
	---help---
		Enable IoT.js framework

if ENABLE_IOTJS

config IOTJS_PRIORITY
        int "IoT.js task priority"
        default 100

config IOTJS_STACKSIZE
        int "IoT.js stack size"
        default 32768

config IOTJS_JERRY_HEAP
        int "Jerryscript Heaplimit"
        default 128

endif #ENABLE_IOTJS
```

## config/tizenrt/artik05x/app/Kconfig
```kconfig
#
# For a description of the syntax of this configuration file,
# see the file kconfig-language.txt in the NuttX tools repository.
#

config SYSTEM_IOTJS
  bool "IoT.js"
  default y
  ---help---
    Enable IoT.js platform

if SYSTEM_IOTJS

config IOTJS_PRIORITY
  int "IoT.js task priority"
  default 100

config IOTJS_STACKSIZE
  int "IoT.js stack size"
  default 32768

endif

config USER_ENTRYPOINT
        string
        default "iotjs_main" if ENTRY_IOTJS
```

## targets/tizenrt-artik05x/app/iotjs/Kconfig
```kconfig
#
# For a description of the syntax of this configuration file,
# see the file kconfig-language.txt in the NuttX tools repository.
#

config SYSTEM_IOTJS
  bool "IoT.js"
  default y
  ---help---
    Enable IoT.js platform

if IOTJS

config IOTJS_PRIORITY
  int "IoT.js task priority"
  default 100

config IOTJS_STACKSIZE
  int "IoT.js stack size"
  default 16384

endif

config USER_ENTRYPOINT
        string
        default "iotjs_main" if ENTRY_IOTJS
```
